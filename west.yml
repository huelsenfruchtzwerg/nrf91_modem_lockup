## west.yml
```yaml
manifest:
  self:
    path: nrf91_modem_lockup
  remotes:
    - name: nrfconnect
      url-base: https://github.com/nrfconnect
    - name: hfz
      url-base: https://github.com/huelsenfruchtzwerg
  projects:
    - name: zephyr
      remote: hfz
      revision: v2.7.0-ncs1-lwm2m-debug-print
      import:
        name-allowlist:
          - TraceRecorderSource
          - canopennode
          - civetweb
          - cmsis
          - edtt
          - fatfs
          - hal_nordic
          - hal_st
          - libmetal
          - littlefs
          - loramac-node
          - lvgl
          - lz4
          - mbedtls
          - mcumgr
          - mipi-sys-t
          - nanopb
          - net-tools
          - nrf_hw_models
          - open-amp
          - openthread
          - segger
          - tinycbor
          - tinycrypt
    - name: sdk-nrf
      remote: nrfconnect
      path: nrf
      revision: v1.8.0
      import: true
```
